## config/boards/shields/nofy/Kconfig.defconfig
```kconfig
if SHIELD_NOFY_R

config ZMK_KEYBOARD_NAME
    default "nofy_R"

config NFCT_PINS_AS_GPIOS
    default y

config ZMK_BLE
    default y

config ZMK_SPLIT
    default y

config ZMK_SPLIT_ROLE_CENTRAL
    default y

config INPUT
    default y

config SPI
    default y

config PMW3610
    bool "Enable PMW3610 sensor"
    default y

endif

if SHIELD_NOFY_L

config ZMK_KEYBOARD_NAME
    default "nofy_L"

config NFCT_PINS_AS_GPIOS
    default y

config ZMK_SPLIT
    default y

endif
```
